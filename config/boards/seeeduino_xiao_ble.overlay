/ {
    leds {
        run_led: led_run {
            gpios = <&gpio0 6 GPIO_ACTIVE_LOW>; /* BLUE LED on P0.06 */
            label = "RUN_LED";
        };
    };

    zmk_indicators: indicators {
        compatible = "zmk,led-indicators";
        status = "okay";
        run-led = <&run_led>;
    };
};
